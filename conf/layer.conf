## conf/layer.conf
```bitbake
# We have a conf and classes directory, add to BBPATH
BBPATH .= ":${LAYERDIR}"

# We have recipes-* directories, add to BBFILES
BBFILES += "${LAYERDIR}/recipes-*/*/*.bb \
            ${LAYERDIR}/recipes-*/*/*.bbappend"

BBFILE_COLLECTIONS += "meta-bbb-driver"
BBFILE_PATTERN_meta-bbb-driver = "^${LAYERDIR}/"
BBFILE_PRIORITY_meta-bbb-driver = "6"

LAYERDEPENDS_meta-bbb-driver = "core"
LAYERSERIES_COMPAT_meta-bbb-driver = "scarthgap"

# Enable systemd for serial console and services
DISTRO_FEATURES:append = " usrmerge systemd"
VIRTUAL-RUNTIME_init_manager = "systemd"
DISTRO_FEATURES_BACKFILL_CONSIDERED += "sysvinit"
VIRTUAL-RUNTIME_initscripts = ""
SYSTEMD_AUTO_ENABLE = "enable"
IMAGE_ROOTFS_MAXSIZE = "3500000"
IMAGE_ROOTFS_SIZE = "3145728"
IMAGE_OVERHEAD_FACTOR = "1.0"
IMAGE_ROOTFS_EXTRA_SPACE = "0"
```
